## board/amlogic/gxb_nanopi_k2/Kconfig
```kconfig
if TARGET_MESON_GX

config SYS_CPU
	string
	default "armv8"

config SYS_BOARD
	string
	default "gxb_nanopi_k2"

config SYS_VENDOR
	string
	default "amlogic"

config SYS_SOC
	string
	default "gxb"

config SYS_CONFIG_NAME
	default "nanopi_k2"

endif
```
